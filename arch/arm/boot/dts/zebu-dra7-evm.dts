/*
 * Copyright (C) 2013 Texas Instruments Incorporated - http://www.ti.com/
 *
 * This program is free software; you can redistribute it and/or modify
 * it under the terms of the GNU General Public License version 2 as
 * published by the Free Software Foundation.
 */
/dts-v1/;

/*
 * Memory is reserved for ipu1 for rearview camera
 */
/*
/memreserve/ 0x8E000000 0x1000000;
/memreserve/ 0xA0000000 0x1800000;
*/

/include/ "zebu-dra7.dtsi"

/ {
	model = "TI DRA7";
	compatible = "ti,dra7-evm", "ti,dra7";

	cpus {
		cpu@0 {
			cpu0-supply = <&abb_mpu>;
		};
	};

	memory {
		device_type = "memory";
		reg = <0x80000000 0x8000000>; /* 128 MB */
	};
};
