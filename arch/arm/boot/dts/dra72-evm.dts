/*
 * Copyright (C) 2014 Texas Instruments Incorporated - http://www.ti.com/
 *
 * This program is free software; you can redistribute it and/or modify
 * it under the terms of the GNU General Public License version 2 as
 * published by the Free Software Foundation.
 */
/dts-v1/;

/include/ "dra72x.dtsi"

/ {
	model = "TI DRA72x";
	compatible = "ti,dra72-evm", "ti,dra72x", "ti,dra7";

	memory {
		device_type = "memory";
		reg = <0x80000000 0x8000000>; /* 128MB for Zebu */
	};

	chosen {
		bootargs = "mem=64M@0x80000000 root=/dev/pmd rootwait rw console=ttyO0,3686400n8 earlyprintk init=/bin/sh";
	};
};

&uart1 {
	status = "okay";
};
