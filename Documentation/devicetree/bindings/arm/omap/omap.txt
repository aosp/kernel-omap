## Documentation/devicetree/bindings/arm/omap/omap.txt
```
* Texas Instruments OMAP

OMAP is currently using a static file per SoC family to describe the
IPs present in the SoC.
On top of that an omap_device is created to extend the platform_device
capabilities and to allow binding with one or several hwmods.
The hwmods will contain all the information to build the device:
address range, irq lines, dma lines, interconnect, PRCM register,
clock domain, input clocks.
For the moment just point to the existing hwmod, the next step will be
to move data from hwmod to device-tree representation.


Required properties:
- compatible: Every devices present in OMAP SoC should be in the
  form: "ti,XXX"
- ti,hwmods: list of hwmod names (ascii strings), that comes from the OMAP
  HW documentation, attached to a device. Must contain at least
  one hwmod.

Optional properties:
- ti,no_idle_on_suspend: When present, it prevents the PM to idle the module
  during suspend.


Example:

spinlock@1 {
    compatible = "ti,omap4-spinlock";
    ti,hwmods = "spinlock";
};

SoC Type (optional):

- General Purpose devices
  compatible = "ti,gp"
- High Security devices
  compatible = "ti,hs"

SoC Families:

- OMAP2 generic - defaults to OMAP2420
  compatible = "ti,omap2"
- OMAP3 generic - defaults to OMAP3430
  compatible = "ti,omap3"
- OMAP4 generic - defaults to OMAP4430
  compatible = "ti,omap4"
- OMAP5 generic - defaults to OMAP5430
  compatible = "ti,omap5"
- DRA7 generic - defaults to DRA742
  compatible = "ti,dra7"
- AM43x generic - defaults to AM4372
  compatible = "ti,am43"

SoCs:

- OMAP2420
  compatible = "ti,omap2420", "ti,omap2"
- OMAP2430
  compatible = "ti,omap2430", "ti,omap2"

- OMAP3430
  compatible = "ti,omap3430", "ti,omap3"
- AM3517
  compatible = "ti,am3517", "ti,omap3"
- OMAP3630
  compatible = "ti,omap36xx", "ti,omap3"
- AM33xx
  compatible = "ti,am33xx", "ti,omap3"

- OMAP4430
  compatible = "ti,omap4430", "ti,omap4"
- OMAP4460
  compatible = "ti,omap4460", "ti,omap4"

- OMAP5430
  compatible = "ti,omap5430", "ti,omap5"
- OMAP5432
  compatible = "ti,omap5432", "ti,omap5"

- DRA74x
  compatible = "ti,dra74x", "ti,dra7xx", "ti,dra7"

- DRA72x
  compatible = "ti,dra72x", "ti,dra7xx", "ti,dra7"

- AM4372
  compatible = "ti,am4372", "ti,am43"

Boards:

- OMAP3 BeagleBoard : Low cost community board
  compatible = "ti,omap3-beagle", "ti,omap3"

- OMAP3 Tobi with Overo : Commercial expansion board with daughter board
  compatible = "ti,omap3-tobi", "ti,omap3-overo", "ti,omap3"

- OMAP4 SDP : Software Developement Board
  compatible = "ti,omap4-sdp", "ti,omap4430"

- OMAP4 PandaBoard : Low cost community board
  compatible = "ti,omap4-panda", "ti,omap4430"

- OMAP3 EVM : Software Developement Board for OMAP35x, AM/DM37x
  compatible = "ti,omap3-evm", "ti,omap3"

- AM335X EVM : Software Developement Board for AM335x
  compatible = "ti,am335x-evm", "ti,am33xx", "ti,omap3"

- AM335X Bone : Low cost community board
  compatible = "ti,am335x-bone", "ti,am33xx", "ti,omap3"

- OMAP5 EVM : Evaluation Module
  compatible = "ti,omap5-evm", "ti,omap5"

- DRA7 EVM:  Software Developement Board for DRA7XX
  compatible = "ti,dra7-evm", "ti,dra74x", "ti,dra7"

- DRA72 EVM: Software Development Board for DRA72x
  compatible = "ti,dra72-evm", "ti,dra72x", "ti,dra7"
```

## Documentation/devicetree/bindings/sound/ti-mcasp-bt.txt
```
SoC Audio support for Bluetooth SCO cards based on the Texas Instruments
McASP controller

Required properties:
- compatible : should contain one of:
    * "ti,dra7xx-wl8-bt" for DRA7 EVM boards with WiLink connectivity
- ti,model : The user-visible name of this sound complex
- ti,mcasp-controller : The phandle of the McASP controller

Optional properties:
- ti,bclk-rate : The rate of the bit clock (when supplied externally by the
  connectivity chip)

Example:
bt_sco_sound {
	     compatible = "ti,dra7xx-wl8-bt";
	     ti,model = "DRA7xx-WiLink";
	     ti,mcasp-controller = <&mcasp7>;
	     ti,bclk-rate = <512000>;
};
```

## drivers/gpu/pvr/Kconfig
```kconfig
# PowerVR SGX driver configuration
config PVR_SGX
	tristate "PowerVR SGX support"
	help
	  Enable this option to build support for the PowerVR SGX 3D core.

	  To compile this driver as a module, choose M here:
	  this will generate two modules, called pvrsrvkm and omaplfb.

choice
	prompt "PowerVR SGX core"
	depends on PVR_SGX
	default PVR_SGXCORE_540

config PVR_SGXCORE_540
	bool "SGX 540"

endchoice

choice
	prompt "PowerVR build type"
	depends on PVR_SGX
	default PVR_BUILD_RELEASE

config PVR_BUILD_RELEASE
	bool "Release"

config PVR_BUILD_DEBUG
	bool "Debug"

endchoice
```
